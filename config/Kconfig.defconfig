## config/Kconfig.defconfig
```kconfig
# Copyright (c) 2020 The ZMK Contributors
# SPDX-License-Identifier: MIT

if SHIELD_dm17

config ZMK_KEYBOARD_NAME
default "dm17"

endif
```

## config/Kconfig.shield
```kconfig
# Copyright (c) 2020 The ZMK Contributors
# SPDX-License-Identifier: MITd

config SHIELD_dm17
def_bool $(shields_list_contains,dm17)
```
